#include "torabo_tsuki_lp.dtsi"
#include <input/processors.dtsi>
#include <dt-bindings/zmk/input_transform.h>

&trackball_listener {
    input-processors = <
        &zip_xy_transform (INPUT_TRANSFORM_X_INVERT | INPUT_TRANSFORM_Y_INVERT)
        &zip_xy_scaler 7 10 /* 0.7倍 */
    >;
    
    scroller {
        layers = <4>;
        input-processors = <
            &zip_xy_transform (INPUT_TRANSFORM_X_INVERT)
            &zip_xy_to_scroll_mapper
            &zip_scroll_scaler 1 2 // 1/2 = 0.5倍
        >;
    };
};
